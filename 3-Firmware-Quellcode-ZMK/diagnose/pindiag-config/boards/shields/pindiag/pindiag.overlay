#include <dt-bindings/zmk/matrix_transform.h>
/ { chosen { zmk,kscan = &kscan0; zmk,matrix-transform = &t0; };
  kscan0: kscan0 { compatible = "zmk,kscan-gpio-direct"; input-gpios
    = <&gpio0 6 (GPIO_ACTIVE_LOW | GPIO_PULL_UP)>
    , <&gpio0 8 (GPIO_ACTIVE_LOW | GPIO_PULL_UP)>
    , <&gpio0 17 (GPIO_ACTIVE_LOW | GPIO_PULL_UP)>
    , <&gpio0 20 (GPIO_ACTIVE_LOW | GPIO_PULL_UP)>
    , <&gpio0 22 (GPIO_ACTIVE_LOW | GPIO_PULL_UP)>
    , <&gpio0 24 (GPIO_ACTIVE_LOW | GPIO_PULL_UP)>
    , <&gpio1 0 (GPIO_ACTIVE_LOW | GPIO_PULL_UP)>
    , <&gpio0 11 (GPIO_ACTIVE_LOW | GPIO_PULL_UP)>
    , <&gpio1 4 (GPIO_ACTIVE_LOW | GPIO_PULL_UP)>
    , <&gpio1 6 (GPIO_ACTIVE_LOW | GPIO_PULL_UP)>
    , <&gpio0 31 (GPIO_ACTIVE_LOW | GPIO_PULL_UP)>
    , <&gpio0 29 (GPIO_ACTIVE_LOW | GPIO_PULL_UP)>
    , <&gpio0 2 (GPIO_ACTIVE_LOW | GPIO_PULL_UP)>
    , <&gpio1 15 (GPIO_ACTIVE_LOW | GPIO_PULL_UP)>
    , <&gpio1 13 (GPIO_ACTIVE_LOW | GPIO_PULL_UP)>
    , <&gpio1 11 (GPIO_ACTIVE_LOW | GPIO_PULL_UP)>
    ; };
  t0: t0 { compatible = "zmk,matrix-transform"; rows = <1>; columns = <16>; map = <
RC(0,0) RC(0,1) RC(0,2) RC(0,3) RC(0,4) RC(0,5) RC(0,6) RC(0,7) RC(0,8) RC(0,9) RC(0,10) RC(0,11) RC(0,12) RC(0,13) RC(0,14) RC(0,15) >; };
};
