## 3-Firmware-Quellcode-ZMK/config/boards/shields/mute_buzzer/Kconfig.defconfig
```kconfig
if SHIELD_MUTE_BUZZER

# Bluetooth-Name, max. 16 Zeichen
config ZMK_KEYBOARD_NAME
    default "Mute-Buzzer"

endif
```
