/*
 * Mute-Buzzer: ein einzelner MX-Switch, direkt verdrahtet.
 * Switch-Beinchen 1 -> Pad "017" (P0.17), Beinchen 2 -> GND.
 * Interner Pull-up, keine Widerstaende/Dioden noetig.
 */
#include <dt-bindings/zmk/matrix_transform.h>

/ {
    chosen {
        zmk,kscan = &kscan0;
        zmk,matrix-transform = &default_transform;
    };

    kscan0: kscan0 {
        compatible = "zmk,kscan-gpio-direct";
        wakeup-source;
        input-gpios = <&gpio0 17 (GPIO_ACTIVE_LOW | GPIO_PULL_UP)>;
    };

    default_transform: keymap_transform_0 {
        compatible = "zmk,matrix-transform";
        rows = <1>;
        columns = <1>;
        map = <RC(0,0)>;
    };
};
